## drivers/android/Kconfig
```kconfig
menu "Android"

config ANDROID
	bool "Android Drivers"
	---help---
	  Enable support for various drivers needed on the Android platform

if ANDROID

config ANDROID_FSTAB_FAKE
	bool "Enable android fstab driver for fake DT fstab"
	depends on PROC_FS
	---help---
	  This is intended to allow early mounting partitions
	  on devices without DT, or where DT can't be modified.

endif # if ANDROID

endmenu
```
