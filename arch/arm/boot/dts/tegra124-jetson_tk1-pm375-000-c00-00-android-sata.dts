#include "tegra124-jetson_tk1-pm375-000-c00-00-android.dts"

/ {
	nvidia,dtsfilename = __FILE__;

	sata@70020000 {
		status = "okay";
		nvidia,enable-sata-port;
		vdd_sata-supply = <&as3722_sd4>;
		avdd_sata_pll-supply =<&as3722_sd4>;
		avdd_sata-supply = <&as3722_sd4>;
		hvdd_sata-supply = <&as3722_gpio2_supply>;
		vddio_pex_sata-supply = <&as3722_gpio2_supply>;
	};

};
