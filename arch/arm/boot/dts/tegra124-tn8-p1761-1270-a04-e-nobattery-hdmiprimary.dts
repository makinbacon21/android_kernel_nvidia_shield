/*
 * Copyright (c) 2015-2016, NVIDIA CORPORATION.  All rights reserved.
 *
 * This program is free software; you can redistribute it and/or modify
 * it under the terms of the GNU General Public License as published by
 * the Free Software Foundation; version 2 of the License.
 *
 * This program is distributed in the hope that it will be useful, but WITHOUT
 * ANY WARRANTY; without even the implied warranty of MERCHANTABILITY or
 * FITNESS FOR A PARTICULAR PURPOSE.  See the GNU General Public License for
 * more details.
 *
 */

#include "tegra124-tn8-p1761-1270-a04-e-nobattery.dts"

/ {
	nvidia,dtsfilename = __FILE__;

	host1x {
		/* tegradc.0 */
		dc@54200000 {
			nvidia,dc-flags = <0>;
			nvidia,emc-clk-rate = <300000000>;
			nvidia,cmu-enable = <0>;
		};

		/* tegradc.1 */
		dc@54240000 {
			status = "disabled";
		};
	};
};
